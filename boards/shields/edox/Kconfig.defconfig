## boards/shields/edox/Kconfig.defconfig
```kconfig
if SHIELD_EDOX_LEFT

config ZMK_KEYBOARD_NAME
    default "edox"

config ZMK_SPLIT_BLE_ROLE_CENTRAL
    default y

endif

if SHIELD_EDOX_LEFT || SHIELD_EDOX_RIGHT

config ZMK_SPLIT
    default y

endif
```

## config/boards/shields/edox/Kconfig.defconfig
```kconfig
if SHIELD_EDOX_LEFT

config ZMK_KEYBOARD_NAME
    default "edox"

config ZMK_SPLIT_BLE_ROLE_CENTRAL
    default y

endif

if SHIELD_EDOX_LEFT || SHIELD_EDOX_RIGHT

config ZMK_SPLIT
    default y

endif

if ZMK_DISPLAY

config I2C
	default y

config SSD1306
	default y

config SSD1306_REVERSE_MODE
	default y

endif # ZMK_DISPLAY
```

## config/boards/shields/edox/Kconfig.shield
```kconfig
config SHIELD_EDOX_LEFT
    def_bool $(shields_list_contains,edox_left)

config SHIELD_EDOX_RIGHT
    def_bool $(shields_list_contains,edox_right)
```
